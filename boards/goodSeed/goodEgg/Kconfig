## boards/goodSeed/goodEgg/Kconfig
```kconfig
# Copyright 2025 NXP
# Copyright (c) 2022 Nordic Semiconductor ASA
# SPDX-License-Identifier: Apache-2.0

config BOARD_GOODEGG
	select BOARD_EARLY_INIT_HOOK
```

## boards/goodSeed/goodEgg/Kconfig.goodEgg
```kconfig
# Copyright 2020, 2024 NXP
# SPDX-License-Identifier: Apache-2.0

config BOARD_GOODEGG
	select SOC_PART_NUMBER_MIMXRT685SFVKB
	select SOC_MIMXRT685S_CM33 if BOARD_GOODEGG_MIMXRT685S_CM33
	select SOC_MIMXRT685S_HIFI4 if BOARD_GOODEGG_MIMXRT685S_HIFI4
```

## boards/goodSeed/goodEgg/board.yml
```yaml
board:
  name: goodEgg 
  full_name: goodEgg 
  vendor: goodSeed
  socs:
    - name: mimxrt685s
```

## drivers/adpd188/Kconfig
```kconfig
config ADPD188BI
    bool "ADPD188BI Smoke Detection Sensor Driver"
    default y
    select SENSOR
    help
      Enable the Zephyr sensor driver for the Analog Devices ADPD188BI.

if ADPD188BI

config ADPD188BI_I2C
    bool "ADPD188BI via I2C"
    default y
    depends on I2C
    help
      Enable I2C support for the ADPD188BI sensor.

endif # ADPD188BI
```

## modules/adpd188/drivers/adpd188/Kconfig
```kconfig
config ADPD188
    bool "ADPD188BI Smoke Detection Sensor Driver"
    depends on SENSOR
    help
      Enable the Zephyr sensor driver for the Analog Devices ADPD188.

if ADPD188

config ADPD188_I2C
    bool "ADPD188 via I2C"
    depends on I2C
    default y
    help
      Enable I2C support for the ADPD188 sensor.

config ADPD188_TRIGGER
    bool "Enable interrupt trigger support"
    depends on GPIO
    select SENSOR_TRIGGER
    default n
    help
      Enable data-ready interrupt support.

endif # ADPD188
```

## modules/adpd188/dts/bindings/analog_adpd188.yaml
```yaml
# Copyright (c) 2022 Nordic Semiconductor ASA
# SPDX-License-Identifier: Apache-2.0

description: |
  ADPD188 is smoke sensor from analog electronics. 

compatible: "analog,adpd188"

include: base.yaml

properties:
  int-gpios:
    type: phandle-array
    required: false
    description: Data-ready interrupt pin 
```

## modules/cd4066b/drivers/cd4066b/Kconfig
```kconfig
menuconfig CD4066B
	bool "CD4066B CMOS Quad Bilateral Switch driver"
	default y
	depends on DT_HAS_TI_CD4066B_ENABLED
	depends on GPIO
	help
	  Enable driver for TI CD4066B CMOS Quad Bilateral Switch.

if CD4066B

config CD4066B_INIT_PRIORITY
	int "CD4066B init priority"
	default 80
	help
	  Device driver initialization priority.

config CD4066B_LOG_LEVEL
	int "CD4066B log level"
	default 3
	range 0 4
	help
	  Log level for CD4066B driver (0=OFF, 1=ERR, 2=WRN, 3=INF, 4=DBG)

endif # CD4066B
```

## modules/cd4066b/dts/bindings/ti,cd4066b.yaml
```yaml
# Copyright (c) 2024
# SPDX-License-Identifier: Apache-2.0

description: |
  TI CD4066B CMOS Quad Bilateral Switch driver.
  Controls analog switches via GPIO pins with interrupt support.

compatible: "ti,cd4066b"

include: base.yaml

properties:
  tx-gpios:
    type: phandle-array
    required: true
    description: GPIO pin to control TX switch (active high)

  rx-gpios:
    type: phandle-array
    required: true
    description: GPIO pin to control RX switch (active high)

  sig-in-gpios:
    type: phandle-array
    required: true
    description: GPIO pin for signal input interrupt
```

## modules/esp_hosted/dts/bindings/espressif,esp-hosted-sdio.yaml
```yaml
# Copyright (c) 2022 Nordic Semiconductor ASA
# SPDX-License-Identifier: Apache-2.0
description: |
    Espressif ESP-Hosted SDIO Wi-Fi offload driver.
    This binding is used for the SDIO implementation of the Hosted protocol,
    typically used with NXP RT600 or similar high-performance hosts.

compatible: "espressif,esp-hosted-sdio"

include: base.yaml

properties:
  reg:
    description: SDIO Function number (should be 1)

  reset-gpios:
    type: phandle-array
    required: true
    description: |
      GPIO connected to the ESP32's EN (Reset) pin.
```

## modules/ledPI22TAT5/ledPI22TAT5/drivers/ledPI22TAT5/Kconfig
```kconfig
config PI22TAT 
    bool "LED driver"
    depends on SPI
    help
      Enable LED driver fori IN-PI22TAT5R5G5B.
```

## modules/tas2563/drivers/tas2563/Kconfig
```kconfig
config TAS2563
    bool "TI TAS2563 SmartAMP Driver"
    default n
    help
      Enable the driver for the Texas Instruments TAS2563 SmartAMP.

if TAS2563

config TAS2563_I2C_ENABLE
    bool "Enable I2C Communication (Default)"
    default y
    # This setting is used to define the -DI2C_ENABLE flag
    depends on TAS2563

config TAS2563_RX_16BIT
    bool "Enable RX 16-bit mode"
    default y
    # This setting is used to define the -DRX_16BIT flag
    depends on TAS2563

config TAS2563_PDM_ENABLE
    bool "Enable PDM recording"
    default n
    depends on TAS2563

endif # TAS2563_SMARTAMP_DRIVER
```

## modules/tas2563/dts/bindings/ti_tas2563.yaml
```yaml
# Copyright (c) 2022 Nordic Semiconductor ASA
# SPDX-License-Identifier: Apache-2.0

description: |
  TAS2563 is Smart Audio amplifier from Texas instruments. 

compatible: "ti,tas2563"

include: base.yaml

properties:
  reset-gpios:
    type: phandle-array
    required: true
    description: Reset pin 
  int-gpios:
    type: phandle-array
    required: false
    description: Over current interrupt pin 
  audio-interface:
    type: phandle
    required: true
    description: Data-ready interrupt pin 
```
